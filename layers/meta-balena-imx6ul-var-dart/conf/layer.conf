## layers/meta-balena-imx6ul-var-dart/conf/layer.conf
```bitbake
BBPATH .= ":${LAYERDIR}"

BBFILES += "${LAYERDIR}/recipes-*/*/*.bb \
            ${LAYERDIR}/recipes-*/*/*.bbappend"

BBFILE_COLLECTIONS += "balena-imx6ul-var-dart"
BBFILE_PATTERN_balena-imx6ul-var-dart := "^${LAYERDIR}/"
BBFILE_PRIORITY_balena-imx6ul-var-dart = "1337"

LAYERSERIES_COMPAT_balena-imx6ul-var-dart = "scarthgap"

# Mask recipes which we do not use
BBMASK += "meta-imx/meta-imx-bsp/recipes-multimedia/pipewire"
BBMASK += "meta-imx/meta-imx-bsp/recipes-multimedia/wireplumber"
BBMASK += "meta-imx/meta-imx-bsp/recipes-security"
BBMASK += "meta-variscite-bsp-common/recipes-connectivity/openthread-iwxxx-spi"
BBMASK += "meta-variscite-bsp-imx/recipes-multimedia/gstreamer"
BBMASK += "meta-variscite-bsp-imx/recipes-connectivity/bluealsa"
BBMASK += "meta-variscite-bsp-imx/dynamic-layers/fsl-bsp-release/recipes-multimedia/pipewire"
BBMASK += "meta-variscite-bsp-common/recipes-multimedia/bluealsa"

SCMVERSION="n"


# Reduce boot-partition footprint: -Os for the packages in
# balena-image-initramfs on var-som-mx6 (see linux-variscite-fslc-imx
# bbappend for the matching kernel-side changes).
CFLAGS:append:pn-busybox:var-som-mx6 = " -Os"
CFLAGS:append:pn-bash:var-som-mx6 = " -Os"
CFLAGS:append:pn-coreutils:var-som-mx6 = " -Os"
CFLAGS:append:pn-jq:var-som-mx6 = " -Os"
CFLAGS:append:pn-dosfstools:var-som-mx6 = " -Os"
CFLAGS:append:pn-e2fsprogs:var-som-mx6 = " -Os"
CFLAGS:append:pn-acl:var-som-mx6 = " -Os"
CFLAGS:append:pn-attr:var-som-mx6 = " -Os"
CFLAGS:append:pn-util-linux:var-som-mx6 = " -Os"
CFLAGS:append:pn-libbsd:var-som-mx6 = " -Os"
CFLAGS:append:pn-libcap:var-som-mx6 = " -Os"
CFLAGS:append:pn-libxcrypt:var-som-mx6 = " -Os"
CFLAGS:append:pn-openssl:var-som-mx6 = " -Os"
CFLAGS:append:pn-gmp:var-som-mx6 = " -Os"
CFLAGS:append:pn-kmod:var-som-mx6 = " -Os"
CFLAGS:append:pn-xz:var-som-mx6 = " -Os"
CFLAGS:append:pn-libmd:var-som-mx6 = " -Os"
CFLAGS:append:pn-onig:var-som-mx6 = " -Os"
CFLAGS:append:pn-readline:var-som-mx6 = " -Os"
CFLAGS:append:pn-libseccomp:var-som-mx6 = " -Os"
CFLAGS:append:pn-systemd:var-som-mx6 = " -Os"
CFLAGS:append:pn-ncurses:var-som-mx6 = " -Os"
CFLAGS:append:pn-zlib:var-som-mx6 = " -Os"
CFLAGS:append:pn-zstd:var-som-mx6 = " -Os"
CFLAGS:append:pn-mtools:var-som-mx6 = " -Os"
CFLAGS:append:pn-parted:var-som-mx6 = " -Os"
CFLAGS:append:pn-shadow:var-som-mx6 = " -Os"
```
