## layers/meta-resin-imx6ul-var-dart/conf/layer.conf
```bitbake
BBPATH .= ":${LAYERDIR}"

BBFILES += "${LAYERDIR}/recipes-*/*/*.bb \
            ${LAYERDIR}/recipes-*/*/*.bbappend"

BBFILE_COLLECTIONS += "resin-imx6ul-var-dart"
BBFILE_PATTERN_resin-imx6ul-var-dart := "^${LAYERDIR}/"
BBFILE_PRIORITY_resin-imx6ul-var-dart = "1337"

LAYERSERIES_COMPAT_resin-imx6ul-var-dart = "sumo"

# Mask recipes which we do not use

# (not masking the following will require us to also add the https://github.com/sbabic/meta-swupdate submodule)
BBMASK ?= ".*/meta-variscite-fslc/recipes-support/swupdate/"

# (not masking the following will require us to also add the https://github.com/meta-qt5/meta-qt5 submodule)
BBMASK .= "|.*/meta-variscite-fslc/recipes-fsl/images/fsl-image-qt5.bb"

# (not masking the following will require us to also add the https://github.com/Freescale/meta-freescale-distro submodule)
BBMASK .= "|.*/meta-variscite-fslc/recipes-fsl/fsl-rc-local/"
BBMASK .= "|.*/meta-variscite-fslc/recipes-fsl/packagegroup/"
BBMASK .= "|.*/meta-variscite-fslc/recipes-core/base-files/"

IMAGE_INSTALL_remove = "fsl-rc-local"
```
